## meta-cmf/conf/layer.conf
```bitbake
BBPATH .= ":${LAYERDIR}"

BBFILES += "\
            ${LAYERDIR}/recipes-*/*/*.bb \
            ${LAYERDIR}/recipes-*/*/*/*.bb \
            ${LAYERDIR}/recipes-*/*/*.bbappend \
            ${LAYERDIR}/recipes-*/*/*/*.bbappend \
           "

BBFILE_COLLECTIONS += "cmf"
BBFILE_PATTERN_cmf := "^${LAYERDIR}/"
#BBFILE_PRIORITY_cmf = "25"

LAYERSERIES_COMPAT_cmf = "dunfell kirkstone"

# Additional license directories.
LICENSE_PATH += "${LAYERDIR}/licenses"

LAYERDEPENDS_cmf = "rdk"

RDK_ROOT_PATH = "${LAYERDIR}/.."

require conf/distro/include/rdkcmf.inc
require conf/distro/include/rdk-external-src.inc
require conf/distro/include/rdk-versions.inc

PREFERRED_PROVIDER_virtual/samplemedia ?= "linaro-samplemedia"
PREFERRED_VERSION_lighttpd = "1.4.39"

#Temporary bbmasks for components that have not been opensourced yet
BBMASK .= "|meta-rdk/recipes-common/rdk-scheduler/"
BBMASK .= "|meta-rdk/recipes-support/rbusmirrors/"
BBMASK .= "|meta-rdk/recipes-support/rbustools/"
BBMASK .= "|meta-rdk-video/recipes-extended/clnl/"
BBMASK .= "|meta-rdk-video/recipes-extended/ctrlm/ctrlm-factory.bb"
BBMASK .= "|meta-rdk-video/recipes-extended/ctrlm/ctrlm-factory-headers.bb"
BBMASK .= "|meta-rdk-video/recipes-extended/thunderstartupservices/"
BBMASK .= "|meta-rdk-broadband/recipes-ccsp/ccsp/batterymgr.bb"
BBMASK .= "|meta-rdk-broadband/recipes-ccsp/ccsp/rdkbgmock.bb"
BBMASK .= "|meta-rdk-broadband/recipes-ccsp/ccsp/rfc-agent.bb"
BBMASK .= "|meta-rdk-broadband/recipes-ccsp/ccsp/gatewaymanager.bb"
BBMASK .= "|meta-rdk-camera/recipes-extended/video-analytics/"
BBMASK .= "|meta-rdk-camera/recipes-multimedia/rtc-signaling/"

# The linux-libc-headers recipe in meta-rdk-ext is for a specific Comcast platform
# and not applicable to CMF platforms
BBMASK_append_morty .= "|meta-rdk-ext/recipes-kernel/linux/linux-libc-headers_3.14.bb"

# Masking the duplicate googletest recipe in meta-rdk-ext. Use the one in
# meta-openembedded
BBMASK .= "|meta-rdk-ext/recipes-test/googletest/"

# Masking recipes for deprecated components that can be overridden in dependent layers
BBMASK += "meta-rdk-restricted/recipes-qt/servicemanager/"
BBMASK += "meta-rdk-restricted/recipes-qt/servicemanagerfunctionaltest/"
BBMASK += "meta-rdk-restricted/recipes-qt/rdkbrowser/"
BBMASK += "meta-rdk-restricted/recipes-extended/podmgr/"
BBMASK += "meta-rdk-video/recipes-extended/asbluetoothrcu/"
BBMASK += "meta-rdk-video/recipes-extended/mediaframework/runpod_git.bb"
BBMASK += "meta-rdk-video/recipes-extended/mediaframework/rmfpodmgr_git.bb"
BBMASK += "meta-rdk-video/recipes-extended/mediaframework/rmfpodmgrheaders_git.bb"
BBMASK += "meta-rdk-video/recipes-extended/mediaframework/rmfpodserver_git.bb"
BBMASK += "meta-rdk-video/recipes-extended/trm/qtapp_git.bb"
BBMASK += "meta-rdk-video/recipes-extended/trm/wsproxy_git.bb"
BBMASK += "meta-rdk/recipes-core/packagegroups/packagegroup-rdk-qt5.bb"
BBMASK += "meta-rdk/recipes-qt/qt5/"
BBMASK += "meta-rdk-ext/recipes-extended/libqjson/"
BBMASK .= "${@bb.utils.contains('DISTRO_FEATURES', 'use_qt5','','\
|meta-cmf-qt5/\
|meta-qt5/\
|meta-rdk-ext/recipes-qt/qt5/\
',d)}"

DISTRO_FEATURES_append_arm = " ld-is-gold"
DISTRO_FEATURES_append_x86 = " ld-is-gold"
DISTRO_FEATURES_append = " virtualization"

DISTRO_FEATURES_append_dunfell = " dunfell"
DISTRO_FEATURES_append_kirkstone = " kirkstone"

DISTRO_FEATURES_append_dunfell = " ssl-1.1.1"

PREFERRED_VERSION_xfsprogs_morty = "4.8.0"
PREFERRED_VERSION_xfsprogs_dunfell = "5.2.1"
PREFERRED_VERSION_plymouth_kirkstone = "0.9.5"

# Masking the below recipes because in kirkstone build recipes pulling older version due to layer priority
BBMASK .= "${@bb.utils.contains('DISTRO_FEATURES', 'kirkstone', '|.meta-rdk-ext/recipes-devtools/jsonrpc/jsonrpc_0.7.0.bb', '', d)}"

# meta-cmf has its own copy of this recipe
BBMASK += "${RDKROOT}/meta-rdk/recipes-containers/lxc-container-generator"
```
